## CMakeLists.txt
```
# SPDX-License-Identifier: Apache-2.0

cmake_minimum_required(VERSION 3.20.0)
find_package(Zephyr REQUIRED HINTS $ENV{ZEPHYR_BASE})
project(l1_e2)

target_sources(app PRIVATE src/main.c src/button.c)
```

## prj.conf
```kconfig
CONFIG_GPIO=y
CONFIG_LOG=y
CONFIG_LOG_DEFAULT_LEVEL=3
CONFIG_DEBUG_OPTIMIZATIONS=y
CONFIG_DEBUG_THREAD_INFO=y
```

## src/main.c
```c
#include <zephyr/kernel.h>
#include <zephyr/device.h>
#include <zephyr/devicetree.h>
#include <zephyr/drivers/gpio.h>

/* Increase the sleep time from 100ms to 10 minutes  */
#define SLEEP_TIME_MS 10*60*1000

/* SW0_NODE is the devicetree node identifier for the "sw0" alias */
#define SW0_NODE DT_ALIAS(sw0)
static const struct gpio_dt_spec button = GPIO_DT_SPEC_GET(SW0_NODE, gpios);

/* LED0_NODE is the devicetree node identifier for the "led0" alias. */
#define LED0_NODE DT_ALIAS(led0)
static const struct gpio_dt_spec led = GPIO_DT_SPEC_GET(LED0_NODE, gpios);

/* Define the callback function */
void button_pressed_callback(const struct device *dev, struct gpio_callback *cb, uint32_t pins)
{
    gpio_pin_toggle_dt(&led);
}

/* Define a variable of type static struct gpio_callback */
static struct gpio_callback button_cb_data;

int main(void)
{
	int ret;

	if (!device_is_ready(led.port)) {
		return -1;
	}

	if (!device_is_ready(button.port)) {
		return -1;
	}

	ret = gpio_pin_configure_dt(&led, GPIO_OUTPUT_ACTIVE);
	if (ret < 0) {
		return -1;
	}

	ret = gpio_pin_configure_dt(&button, GPIO_INPUT);
	if (ret < 0) {
		return -1;
	}
	/* Configure the interrupt on the button's pin */
    ret = gpio_pin_interrupt_configure_dt(&button, GPIO_INT_EDGE_TO_ACTIVE);
	/* Initialize the static struct gpio_callback variable   */
    gpio_init_callback(&button_cb_data, button_pressed_callback, BIT(button.pin)); 	

	/* Add the callback function by calling gpio_add_callback()   */
    gpio_add_callback(button.port, &button_cb_data);

	while (1) {
		k_msleep(SLEEP_TIME_MS);
	}
}
```

## src/button.c
```c
#include <zephyr/kernel.h>
#include <zephyr/devicetree.h>
#include <zephyr/drivers/gpio.h>
#include "button.h"

/* Use the devicetree alias "sw0" if present */
#define BUTTON_NODE DT_ALIAS(sw0)

static const struct gpio_dt_spec button = GPIO_DT_SPEC_GET_OR(BUTTON_NODE, gpios, {0});

int button_init(void)
{
    /* If the alias/node isn't present, gpio_is_ready_dt will be false */
    if (!gpio_is_ready_dt(&button)) {
        return -ENOTSUP;
    }

    return gpio_pin_configure_dt(&button, GPIO_INPUT);
}

bool button_pressed(void)
{
    if (!gpio_is_ready_dt(&button)) {
        return false;
    }

    int val = gpio_pin_get_dt(&button);
    /* Many boards use active-low buttons; treat 0 as pressed */
    return (val == 0);
}
```

## src/button.h
```c
#ifndef BUTTON_H
#define BUTTON_H

#include <stdbool.h>

/* Initialize button (returns 0 on success, -ENOTSUP if button not present) */
int button_init(void);

/* Returns true if button currently pressed. If button not present, returns false. */
bool button_pressed(void);

#endif /* BUTTON_H */
```
